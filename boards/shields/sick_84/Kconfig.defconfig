## boards/shields/sick_84/Kconfig.defconfig
```kconfig
if SHIELD_SICK_84

config ZMK_KEYBOARD_NAME
    default "SiCK-84"

endif # SHIELD_SICK_84
```

## config/west.yml
```yaml
manifest:
  remotes:
  - name: zmkfirmware
    url-base: https://github.com/zmkfirmware
    # Additional modules containing boards/shields/custom code can be listed here as well
  - name: petejohanson
    url-base: https://github.com/petejohanson/zmk.git
    # See https://docs.zephyrproject.org/3.2.0/develop/west/manifest.html#projects

  projects:
  - name: zmk
    # remote: zmkfirmware
    remote: petejohanson
    revision: main
    import: app/west.yml
  - name: zmk-locales
    url: https://github.com/joelspadin/zmk-locales.git
    revision: main
    path: modules/zmk-locales
  self:
    path: config
```
